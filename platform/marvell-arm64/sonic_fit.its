## platform/marvell-arm64/sonic_fit.its
```
/dts-v1/;
  
/ {
    description = "U-Boot fitImage for SONIC Marvell Arm64";
    #address-cells = <1>;
  
    images {
        kernel_ac5x {
            description = "Linux Kernel for AC5x";
            data = /incbin/("/boot/vmlinuz-5.10.0-18-2-arm64");
            type = "kernel";
            arch = "arm64";
            os = "linux";
            compression = "none";
            load = <0x2 0x2080000>;
            entry = <0x2 0x2080000>;
            hash@1 {
                algo = "sha1";
            };
        };
        fdt_ac5x {
            description = "Flattened Device Tree blob for AC5x";
            data = /incbin/("/usr/lib/linux-image-5.10.0-18-2-arm64/marvell/ac5-98dx35xx-rd.dtb");
            type = "flat_dt";
            arch = "arm64";
            compression = "none";
            load = <0x2 0x1000000>;
            hash@1 {
                algo = "sha1";
            };
        };
        ramdisk_ac5x {
            description = "ramdisk for AC5x";
            data = /incbin/("/boot/initrd.img-5.10.0-18-2-arm64");
            type = "ramdisk";
            arch = "arm64";
            os = "linux";
            compression = "gzip";
            load = <0x2 0x6000000>;
            entry = <0x2 0x6000000>;
            hash@1 {
                algo = "sha1";
            };
        };
        kernel_7020 {
            description = "Linux Kernel";
            data = /incbin/("/boot/vmlinuz-5.10.0-18-2-arm64");
            type = "kernel";
            arch = "arm64";
            os = "linux";
            compression = "none";
            load = <0x2000000>;
            entry = <0x2000000>;
            hash@1 {
                algo = "sha1";
            };
        };
        fdt_7020 {
            description = "Flattened Device Tree blob";
            data = /incbin/("/usr/lib/linux-image-5.10.0-18-2-arm64/marvell/armada-7020-comexpress.dtb");
            type = "flat_dt";
            arch = "arm64";
            compression = "none";
            load = <0x1000000>;
            entry = <0x1000000>;
            hash@1 {
                algo = "sha1";
            };
        };
        ramdisk_7020 {
            description = "ramdisk";
            data = /incbin/("/boot/initrd.img-5.10.0-18-2-arm64");
            type = "ramdisk";
            arch = "arm64";
            os = "linux";
            compression = "gzip";
            load = <0x6000000>;
            entry = <0x6000000>;
            hash@1 {
                algo = "sha1";
            };
        };
    };
    configurations {
        default = "conf_ac5x";
        conf_ac5x {
            description = "Boot Linux kernel with FDT blob + ramdisk for RD_AC5x";
            kernel = "kernel_ac5x";
            fdt = "fdt_ac5x";
            ramdisk = "ramdisk_ac5x";
            hash@1 {
                algo = "sha1";
            };
        };
        conf@1 {
            description = "Boot Linux kernel with FDT blob + ramdisk for Armada7020";
            kernel = "kernel_7020";
            fdt = "fdt_7020";
            ramdisk = "ramdisk_7020";
            hash@1 {
                algo = "sha1";
            };
        };
   };
};
```
